## 3rd-party/mqttclient/Kconfig
```kconfig
menuconfig MQTT_LOG_IS_SALOF
    bool "Enable MQTTClient SALOF support"
    default n
```

## Kconfig
```kconfig
menu "RT-Smart UserSpace Libraries Configuration"

    source "$(SDK_RTSMART_SRC_DIR)/libs/3rd-party/Kconfig"
    source "$(SDK_RTSMART_SRC_DIR)/libs/rtsmart_hal/Kconfig"

endmenu
```

## testcases/Kconfig
```kconfig
menuconfig RTSMART_LIBS_ENABLE_TESTCASES
    bool "Enable Build RtSmart Libraries Testcases"
    select RTSMART_COPY_LIBS_TEST
    default n

    if RTSMART_LIBS_ENABLE_TESTCASES
        config RTSMART_3RD_PARTY_ENABLE_MBEDTLS_TESTS
            bool "Enable Build MbedTLS Test Programs"
            depends on RTSMART_3RD_PARTY_ENABLE_MBEDTLS
            default n

        config RTSMART_LIBS_HAL_ENABLE_TESTS
            bool "Enable Build RtSmart Hal Drivers Tests"
            default n

        config RTSMART_LIBS_MQTTCLIENT_ENABLE_TESTS
            bool "Enable Build RtSmart MQTT Client Tests"
            default n
    endif
```
